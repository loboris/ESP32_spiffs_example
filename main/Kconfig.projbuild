## main/Kconfig.projbuild
```kconfig
menu "SPIffs Example Configuration"

config EXAMPLE_RUN_MULTITASK_TEST
    bool "Run multitask test"
    default n
    help
        Run multitask test, 3 tasks are created.
        Each task will perform 1000 read&write operations.

config EXAMPLE_USE_WIFI
    bool "Use wifi in this example"
    default n
    help
        If WiFi is used ntp server will be used to provide the exact time
        and file timestamps will be correct.

config WIFI_SSID
    string "WiFi SSID"
   	depends on EXAMPLE_USE_WIFI
    default "myssid"
    help
	SSID (network name) for the example to connect to.

config WIFI_PASSWORD
    string "WiFi Password"
   	depends on EXAMPLE_USE_WIFI
    default "mypassword"
    help
	WiFi password (WPA or WPA2) for the example to use.


endmenu
```
